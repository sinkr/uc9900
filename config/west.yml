## config/west.yml
```yaml
manifest:
  remotes:
    - name: zmkfirmware
      url-base: https://github.com/zmkfirmware
    - name: ZitaoTech
      url-base: https://github.com/ZitaoTech
    - name: sinkr
      url-base: https://github.com/sinkr
  projects:
    - name: zmk
      remote: sinkr
      revision: bbkeyboard_tp
      import: app/west.yml
  self:
    path: config
```
